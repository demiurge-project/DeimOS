## poky/meta-epuck/conf/layer.conf
```bitbake
# We have a conf and classes directory, add to BBPATH
BBPATH .= ":${LAYERDIR}"

# We have recipes-* directories, add to BBFILES
BBFILES += "${LAYERDIR}/recipes-*/*/*.bb \
            ${LAYERDIR}/recipes-*/*/*.bbappend"

BBFILE_COLLECTIONS += "meta-epuck"
BBFILE_PATTERN_meta-epuck = "^${LAYERDIR}/"
BBFILE_PRIORITY_meta-epuck = "7"

LAYERSERIES_COMPAT_meta-epuck = "warrior"
```
